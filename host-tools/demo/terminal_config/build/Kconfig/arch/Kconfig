## host-tools/demo/terminal_config/build/Kconfig/arch/Kconfig
```kconfig
# Load Zephyr Arch Kconfig descriptions.
osource "/sripiranavan/installs/Embedded/RTOS/zephyrproject/zephyr/arch/rx/Kconfig"
osource "/sripiranavan/installs/Embedded/RTOS/zephyrproject/zephyr/arch/x86/Kconfig"
osource "/sripiranavan/installs/Embedded/RTOS/zephyrproject/zephyr/arch/xtensa/Kconfig"
osource "/sripiranavan/installs/Embedded/RTOS/zephyrproject/zephyr/arch/sparc/Kconfig"
osource "/sripiranavan/installs/Embedded/RTOS/zephyrproject/zephyr/arch/riscv/Kconfig"
osource "/sripiranavan/installs/Embedded/RTOS/zephyrproject/zephyr/arch/posix/Kconfig"
osource "/sripiranavan/installs/Embedded/RTOS/zephyrproject/zephyr/arch/openrisc/Kconfig"
osource "/sripiranavan/installs/Embedded/RTOS/zephyrproject/zephyr/arch/mips/Kconfig"
osource "/sripiranavan/installs/Embedded/RTOS/zephyrproject/zephyr/arch/arm64/Kconfig"
osource "/sripiranavan/installs/Embedded/RTOS/zephyrproject/zephyr/arch/arm/Kconfig"
osource "/sripiranavan/installs/Embedded/RTOS/zephyrproject/zephyr/arch/arc/Kconfig"
```

## host-tools/demo/terminal_config/build/Kconfig/boards/Kconfig
```kconfig
# Load Zephyr board Kconfig descriptions.
osource "/sripiranavan/installs/Embedded/RTOS/zephyrproject/zephyr/boards/st/nucleo_f439zi/Kconfig"
```

## host-tools/demo/terminal_config/build/Kconfig/boards/Kconfig.defconfig
```kconfig
# Load Zephyr board defconfig descriptions.
osource "/sripiranavan/installs/Embedded/RTOS/zephyrproject/zephyr/boards/st/nucleo_f439zi/Kconfig.defconfig"
```

## host-tools/demo/terminal_config/build/Kconfig/boards/Kconfig.nucleo_f439zi
```kconfig
# Load board Kconfig descriptions.
osource "/sripiranavan/installs/Embedded/RTOS/zephyrproject/zephyr/boards/st/nucleo_f439zi/Kconfig.nucleo_f439zi"
```

## host-tools/demo/terminal_config/build/Kconfig/soc/Kconfig
```kconfig
# Load Zephyr SoC Kconfig descriptions.
osource "/sripiranavan/installs/Embedded/RTOS/zephyrproject/zephyr/soc/xlnx/zynqmp/Kconfig"
osource "/sripiranavan/installs/Embedded/RTOS/zephyrproject/zephyr/soc/xlnx/zynq7000/Kconfig"
osource "/sripiranavan/installs/Embedded/RTOS/zephyrproject/zephyr/soc/xlnx/versalnet/Kconfig"
osource "/sripiranavan/installs/Embedded/RTOS/zephyrproject/zephyr/soc/xlnx/versal2/Kconfig"
osource "/sripiranavan/installs/Embedded/RTOS/zephyrproject/zephyr/soc/xlnx/versal/Kconfig"
osource "/sripiranavan/installs/Embedded/RTOS/zephyrproject/zephyr/soc/xen/Kconfig"
osource "/sripiranavan/installs/Embedded/RTOS/zephyrproject/zephyr/soc/wch/ch32v/Kconfig"
osource "/sripiranavan/installs/Embedded/RTOS/zephyrproject/zephyr/soc/ti/simplelink/Kconfig"
osource "/sripiranavan/installs/Embedded/RTOS/zephyrproject/zephyr/soc/ti/mspm/Kconfig"
osource "/sripiranavan/installs/Embedded/RTOS/zephyrproject/zephyr/soc/ti/lm3s6965/Kconfig"
osource "/sripiranavan/installs/Embedded/RTOS/zephyrproject/zephyr/soc/ti/k3/Kconfig"
osource "/sripiranavan/installs/Embedded/RTOS/zephyrproject/zephyr/soc/ti/am13/Kconfig"
osource "/sripiranavan/installs/Embedded/RTOS/zephyrproject/zephyr/soc/telink/tlsr/Kconfig"
osource "/sripiranavan/installs/Embedded/RTOS/zephyrproject/zephyr/soc/syna/sr100/Kconfig"
osource "/sripiranavan/installs/Embedded/RTOS/zephyrproject/zephyr/soc/starfive/jh71xx/Kconfig"
osource "/sripiranavan/installs/Embedded/RTOS/zephyrproject/zephyr/soc/st/stm32/Kconfig"
osource "/sripiranavan/installs/Embedded/RTOS/zephyrproject/zephyr/soc/snps/qemu_arc/Kconfig"
osource "/sripiranavan/installs/Embedded/RTOS/zephyrproject/zephyr/soc/snps/nsim/arc_v/Kconfig"
osource "/sripiranavan/installs/Embedded/RTOS/zephyrproject/zephyr/soc/snps/nsim/arc_classic/Kconfig"
osource "/sripiranavan/installs/Embedded/RTOS/zephyrproject/zephyr/soc/snps/hsdk4xd/Kconfig"
osource "/sripiranavan/installs/Embedded/RTOS/zephyrproject/zephyr/soc/snps/hsdk/Kconfig"
osource "/sripiranavan/installs/Embedded/RTOS/zephyrproject/zephyr/soc/snps/emsk/Kconfig"
osource "/sripiranavan/installs/Embedded/RTOS/zephyrproject/zephyr/soc/snps/emsdp/Kconfig"
osource "/sripiranavan/installs/Embedded/RTOS/zephyrproject/zephyr/soc/snps/arc_iot/Kconfig"
osource "/sripiranavan/installs/Embedded/RTOS/zephyrproject/zephyr/soc/silabs/Kconfig"
osource "/sripiranavan/installs/Embedded/RTOS/zephyrproject/zephyr/soc/sifli/sf32/Kconfig"
osource "/sripiranavan/installs/Embedded/RTOS/zephyrproject/zephyr/soc/sifive/sifive_freedom/Kconfig"
osource "/sripiranavan/installs/Embedded/RTOS/zephyrproject/zephyr/soc/shakti/Kconfig"
osource "/sripiranavan/installs/Embedded/RTOS/zephyrproject/zephyr/soc/sensry/Kconfig"
osource "/sripiranavan/installs/Embedded/RTOS/zephyrproject/zephyr/soc/rockchip/Kconfig"
osource "/sripiranavan/installs/Embedded/RTOS/zephyrproject/zephyr/soc/renode/riscv_virtual/Kconfig"
osource "/sripiranavan/installs/Embedded/RTOS/zephyrproject/zephyr/soc/renode/cortex_r8_virtual/Kconfig"
osource "/sripiranavan/installs/Embedded/RTOS/zephyrproject/zephyr/soc/renesas/smartbond/Kconfig"
osource "/sripiranavan/installs/Embedded/RTOS/zephyrproject/zephyr/soc/renesas/rz/Kconfig"
osource "/sripiranavan/installs/Embedded/RTOS/zephyrproject/zephyr/soc/renesas/rx/Kconfig"
osource "/sripiranavan/installs/Embedded/RTOS/zephyrproject/zephyr/soc/renesas/rcar/Kconfig"
osource "/sripiranavan/installs/Embedded/RTOS/zephyrproject/zephyr/soc/renesas/ra/Kconfig"
osource "/sripiranavan/installs/Embedded/RTOS/zephyrproject/zephyr/soc/realtek/fingerprint/Kconfig"
osource "/sripiranavan/installs/Embedded/RTOS/zephyrproject/zephyr/soc/realtek/ec/Kconfig"
osource "/sripiranavan/installs/Embedded/RTOS/zephyrproject/zephyr/soc/realtek/bee/Kconfig"
osource "/sripiranavan/installs/Embedded/RTOS/zephyrproject/zephyr/soc/realtek/ameba/Kconfig"
osource "/sripiranavan/installs/Embedded/RTOS/zephyrproject/zephyr/soc/raspberrypi/rpi_pico/Kconfig"
osource "/sripiranavan/installs/Embedded/RTOS/zephyrproject/zephyr/soc/quicklogic/eos_s3/Kconfig"
osource "/sripiranavan/installs/Embedded/RTOS/zephyrproject/zephyr/soc/qemu/virt_riscv/Kconfig"
osource "/sripiranavan/installs/Embedded/RTOS/zephyrproject/zephyr/soc/qemu/or1k/Kconfig"
osource "/sripiranavan/installs/Embedded/RTOS/zephyrproject/zephyr/soc/qemu/malta/Kconfig"
osource "/sripiranavan/installs/Embedded/RTOS/zephyrproject/zephyr/soc/openisa/rv32m1/Kconfig"
osource "/sripiranavan/installs/Embedded/RTOS/zephyrproject/zephyr/soc/openhwgroup/cva6/Kconfig"
osource "/sripiranavan/installs/Embedded/RTOS/zephyrproject/zephyr/soc/oct/osd32mp15x/Kconfig"
osource "/sripiranavan/installs/Embedded/RTOS/zephyrproject/zephyr/soc/nxp/s32/Kconfig"
osource "/sripiranavan/installs/Embedded/RTOS/zephyrproject/zephyr/soc/nxp/rw/Kconfig"
osource "/sripiranavan/installs/Embedded/RTOS/zephyrproject/zephyr/soc/nxp/mcx/Kconfig"
osource "/sripiranavan/installs/Embedded/RTOS/zephyrproject/zephyr/soc/nxp/lpc/Kconfig"
osource "/sripiranavan/installs/Embedded/RTOS/zephyrproject/zephyr/soc/nxp/layerscape/Kconfig"
osource "/sripiranavan/installs/Embedded/RTOS/zephyrproject/zephyr/soc/nxp/kinetis/Kconfig"
osource "/sripiranavan/installs/Embedded/RTOS/zephyrproject/zephyr/soc/nxp/imxrt/Kconfig"
osource "/sripiranavan/installs/Embedded/RTOS/zephyrproject/zephyr/soc/nxp/imx/Kconfig"
osource "/sripiranavan/installs/Embedded/RTOS/zephyrproject/zephyr/soc/nuvoton/numicro/Kconfig"
osource "/sripiranavan/installs/Embedded/RTOS/zephyrproject/zephyr/soc/nuvoton/numaker/Kconfig"
osource "/sripiranavan/installs/Embedded/RTOS/zephyrproject/zephyr/soc/nuvoton/npcx/Kconfig"
osource "/sripiranavan/installs/Embedded/RTOS/zephyrproject/zephyr/soc/nuvoton/npcm/Kconfig"
osource "/sripiranavan/installs/Embedded/RTOS/zephyrproject/zephyr/soc/nordic/Kconfig"
osource "/sripiranavan/installs/Embedded/RTOS/zephyrproject/zephyr/soc/neorv32/Kconfig"
osource "/sripiranavan/installs/Embedded/RTOS/zephyrproject/zephyr/soc/native/inf_clock/Kconfig"
osource "/sripiranavan/installs/Embedded/RTOS/zephyrproject/zephyr/soc/microchip/smartfusion2/Kconfig"
osource "/sripiranavan/installs/Embedded/RTOS/zephyrproject/zephyr/soc/microchip/sam/sama7/Kconfig"
osource "/sripiranavan/installs/Embedded/RTOS/zephyrproject/zephyr/soc/microchip/sam/sam_d5x_e5x/Kconfig"
osource "/sripiranavan/installs/Embedded/RTOS/zephyrproject/zephyr/soc/microchip/pic64/Kconfig"
osource "/sripiranavan/installs/Embedded/RTOS/zephyrproject/zephyr/soc/microchip/pic32c/pic32cz_ca/Kconfig"
osource "/sripiranavan/installs/Embedded/RTOS/zephyrproject/zephyr/soc/microchip/pic32c/pic32cx_sg/Kconfig"
osource "/sripiranavan/installs/Embedded/RTOS/zephyrproject/zephyr/soc/microchip/pic32c/pic32cm_sg_gc/Kconfig"
osource "/sripiranavan/installs/Embedded/RTOS/zephyrproject/zephyr/soc/microchip/pic32c/pic32cm_pl/Kconfig"
osource "/sripiranavan/installs/Embedded/RTOS/zephyrproject/zephyr/soc/microchip/pic32c/pic32cm_jh/Kconfig"
osource "/sripiranavan/installs/Embedded/RTOS/zephyrproject/zephyr/soc/microchip/pic32c/pic32ck_sg_gc/Kconfig"
osource "/sripiranavan/installs/Embedded/RTOS/zephyrproject/zephyr/soc/microchip/miv/Kconfig"
osource "/sripiranavan/installs/Embedded/RTOS/zephyrproject/zephyr/soc/microchip/mec/Kconfig"
osource "/sripiranavan/installs/Embedded/RTOS/zephyrproject/zephyr/soc/mediatek/mt8xxx/Kconfig"
osource "/sripiranavan/installs/Embedded/RTOS/zephyrproject/zephyr/soc/lowrisc/opentitan/Kconfig"
osource "/sripiranavan/installs/Embedded/RTOS/zephyrproject/zephyr/soc/litex/Kconfig"
osource "/sripiranavan/installs/Embedded/RTOS/zephyrproject/zephyr/soc/ite/ec/Kconfig"
osource "/sripiranavan/installs/Embedded/RTOS/zephyrproject/zephyr/soc/intel/wildcat_lake/Kconfig"
osource "/sripiranavan/installs/Embedded/RTOS/zephyrproject/zephyr/soc/intel/raptor_lake/Kconfig"
osource "/sripiranavan/installs/Embedded/RTOS/zephyrproject/zephyr/soc/intel/panther_lake/Kconfig"
osource "/sripiranavan/installs/Embedded/RTOS/zephyrproject/zephyr/soc/intel/nova_lake/Kconfig"
osource "/sripiranavan/installs/Embedded/RTOS/zephyrproject/zephyr/soc/intel/lakemont/Kconfig"
osource "/sripiranavan/installs/Embedded/RTOS/zephyrproject/zephyr/soc/intel/intel_socfpga_std/Kconfig"
osource "/sripiranavan/installs/Embedded/RTOS/zephyrproject/zephyr/soc/intel/intel_socfpga/Kconfig"
osource "/sripiranavan/installs/Embedded/RTOS/zephyrproject/zephyr/soc/intel/intel_niosv/Kconfig"
osource "/sripiranavan/installs/Embedded/RTOS/zephyrproject/zephyr/soc/intel/intel_ish/Kconfig"
osource "/sripiranavan/installs/Embedded/RTOS/zephyrproject/zephyr/soc/intel/intel_adsp/Kconfig"
osource "/sripiranavan/installs/Embedded/RTOS/zephyrproject/zephyr/soc/intel/elkhart_lake/Kconfig"
osource "/sripiranavan/installs/Embedded/RTOS/zephyrproject/zephyr/soc/intel/atom/Kconfig"
osource "/sripiranavan/installs/Embedded/RTOS/zephyrproject/zephyr/soc/intel/apollo_lake/Kconfig"
osource "/sripiranavan/installs/Embedded/RTOS/zephyrproject/zephyr/soc/intel/alder_lake/Kconfig"
osource "/sripiranavan/installs/Embedded/RTOS/zephyrproject/zephyr/soc/infineon/psoc4/Kconfig"
osource "/sripiranavan/installs/Embedded/RTOS/zephyrproject/zephyr/soc/infineon/edge/Kconfig"
osource "/sripiranavan/installs/Embedded/RTOS/zephyrproject/zephyr/soc/infineon/cat3/Kconfig"
osource "/sripiranavan/installs/Embedded/RTOS/zephyrproject/zephyr/soc/infineon/cat1c/Kconfig"
osource "/sripiranavan/installs/Embedded/RTOS/zephyrproject/zephyr/soc/infineon/cat1b/Kconfig"
osource "/sripiranavan/installs/Embedded/RTOS/zephyrproject/zephyr/soc/infineon/cat1a/Kconfig"
osource "/sripiranavan/installs/Embedded/RTOS/zephyrproject/zephyr/soc/gd/gd32/Kconfig"
osource "/sripiranavan/installs/Embedded/RTOS/zephyrproject/zephyr/soc/gaisler/leon3/Kconfig"
osource "/sripiranavan/installs/Embedded/RTOS/zephyrproject/zephyr/soc/gaisler/gr716a/Kconfig"
osource "/sripiranavan/installs/Embedded/RTOS/zephyrproject/zephyr/soc/focaltech/Kconfig"
osource "/sripiranavan/installs/Embedded/RTOS/zephyrproject/zephyr/soc/espressif/Kconfig"
osource "/sripiranavan/installs/Embedded/RTOS/zephyrproject/zephyr/soc/ene/kb1200/Kconfig"
osource "/sripiranavan/installs/Embedded/RTOS/zephyrproject/zephyr/soc/ene/kb106x/Kconfig"
osource "/sripiranavan/installs/Embedded/RTOS/zephyrproject/zephyr/soc/elan/em32f967/Kconfig"
osource "/sripiranavan/installs/Embedded/RTOS/zephyrproject/zephyr/soc/egis/Kconfig"
osource "/sripiranavan/installs/Embedded/RTOS/zephyrproject/zephyr/soc/efinix/sapphire/Kconfig"
osource "/sripiranavan/installs/Embedded/RTOS/zephyrproject/zephyr/soc/cdns/xtensa_sample_controller/Kconfig"
osource "/sripiranavan/installs/Embedded/RTOS/zephyrproject/zephyr/soc/cdns/swerv/Kconfig"
osource "/sripiranavan/installs/Embedded/RTOS/zephyrproject/zephyr/soc/cdns/sample_controller32/Kconfig"
osource "/sripiranavan/installs/Embedded/RTOS/zephyrproject/zephyr/soc/cdns/dc233c/Kconfig"
osource "/sripiranavan/installs/Embedded/RTOS/zephyrproject/zephyr/soc/brcm/bcmvk/Kconfig"
osource "/sripiranavan/installs/Embedded/RTOS/zephyrproject/zephyr/soc/brcm/bcm2712/Kconfig"
osource "/sripiranavan/installs/Embedded/RTOS/zephyrproject/zephyr/soc/brcm/bcm2711/Kconfig"
osource "/sripiranavan/installs/Embedded/RTOS/zephyrproject/zephyr/soc/blackberry/qnxhv_vm/Kconfig"
osource "/sripiranavan/installs/Embedded/RTOS/zephyrproject/zephyr/soc/bflb/Kconfig"
osource "/sripiranavan/installs/Embedded/RTOS/zephyrproject/zephyr/soc/atmel/sam0/Kconfig"
osource "/sripiranavan/installs/Embedded/RTOS/zephyrproject/zephyr/soc/atmel/sam/Kconfig"
osource "/sripiranavan/installs/Embedded/RTOS/zephyrproject/zephyr/soc/aspeed/Kconfig"
osource "/sripiranavan/installs/Embedded/RTOS/zephyrproject/zephyr/soc/arm/Kconfig"
osource "/sripiranavan/installs/Embedded/RTOS/zephyrproject/zephyr/soc/arm/beetle/Kconfig"
osource "/sripiranavan/installs/Embedded/RTOS/zephyrproject/zephyr/soc/antmicro/myra/Kconfig"
osource "/sripiranavan/installs/Embedded/RTOS/zephyrproject/zephyr/soc/andestech/Kconfig"
osource "/sripiranavan/installs/Embedded/RTOS/zephyrproject/zephyr/soc/amd/acp_7_x/Kconfig"
osource "/sripiranavan/installs/Embedded/RTOS/zephyrproject/zephyr/soc/amd/acp_7_0/Kconfig"
osource "/sripiranavan/installs/Embedded/RTOS/zephyrproject/zephyr/soc/amd/acp_6_0/Kconfig"
osource "/sripiranavan/installs/Embedded/RTOS/zephyrproject/zephyr/soc/ambiq/Kconfig"
osource "/sripiranavan/installs/Embedded/RTOS/zephyrproject/zephyr/soc/allwinner/sun8i_h3/Kconfig"
osource "/sripiranavan/installs/Embedded/RTOS/zephyrproject/zephyr/soc/allwinner/sun50i_h618/Kconfig"
osource "/sripiranavan/installs/Embedded/RTOS/zephyrproject/zephyr/soc/alif/ensemble/Kconfig"
osource "/sripiranavan/installs/Embedded/RTOS/zephyrproject/zephyr/soc/alif/balletto/Kconfig"
osource "/sripiranavan/installs/Embedded/RTOS/zephyrproject/zephyr/soc/aesc/Kconfig"
osource "/sripiranavan/installs/Embedded/RTOS/zephyrproject/zephyr/soc/adi/max32/Kconfig"
```
